## CMakeLists.txt
```
# SPDX-License-Identifier: Apache-2.0

cmake_minimum_required(VERSION 3.20.0)

find_package(Zephyr REQUIRED HINTS $ENV{ZEPHYR_BASE})
project(C++Embedded)

target_sources(app PRIVATE 
  src/main.cpp
  src/alc_ui.cpp)

zephyr_library_include_directories(.)
```

## prj.conf
```kconfig
# C++
CONFIG_CPP=y
CONFIG_STD_CPP20=y
CONFIG_REQUIRES_FULL_LIBCPP=y

# Button and LED support
CONFIG_DK_LIBRARY=y

# Logging
CONFIG_LOG=y
# CONFIG_LOG_DEFAULT_LEVEL=3

# Enable RTT as logging backend
# CONFIG_USE_SEGGER_RTT=y
# CONFIG_LOG_BACKEND_RTT=y

# Disable UART backend (optional, if you only want RTT)
CONFIG_LOG_BACKEND_UART=y

#Debugging
CONFIG_DEBUG=y
CONFIG_DEBUG_OPTIMIZATIONS=y
CONFIG_DEBUG_THREAD_INFO=y
```

## src/main.cpp
```c
#include <zephyr/kernel.h>
#include <zephyr/logging/log.h>

#include "lib/alc_ui.h"

LOG_MODULE_REGISTER(main, LOG_LEVEL_INF);

#define BUFFER_SIZE 5

typedef struct 
{
  int intArray[BUFFER_SIZE]; // Array to store integer values.
  size_t writeIndex;
  size_t readIndex;
  size_t count;
} int_ring_buffer;

void initRingBuffer(int_ring_buffer* rb)
{
  rb->writeIndex = 0;
  rb->readIndex = 0;
  rb->count = 0;
}

void ringBufferPush(int_ring_buffer* rb, int value)
{
  rb->intArray[rb->writeIndex] = value;
  rb->writeIndex = (++rb->writeIndex % BUFFER_SIZE);
  if (rb->count < BUFFER_SIZE) {
    ++rb->count;
    return;
  }
  // Buffer is full.
  rb->readIndex = (++rb->readIndex % BUFFER_SIZE);
}

int ringBufferPop(int_ring_buffer* rb)
{
  if (rb->count ==  0) { return 0; };
  int value = rb->intArray[rb->readIndex];
  rb->readIndex = (++rb->readIndex % BUFFER_SIZE);
  --rb->count;
  return value;
}

void printBuffer(int_ring_buffer* rb)
{
  for (int i = 0; i < BUFFER_SIZE; i++)
  {
    LOG_INF("%d, %d", i, rb->intArray[i]);
  }
  LOG_INF("Read Index: %d, Write Index: %d, Count: %d", rb->readIndex, rb->writeIndex, rb->count);
}

alc::ui::Ui ui;

int counter = 0;

int main(void)
{
  // Page 8.  Example of C implementation of simple ring buffer.

  // C.
  int_ring_buffer rb;
  initRingBuffer(&rb);

  // Initialse buffer;
  for (int i = 0; i < BUFFER_SIZE; i++)
  {
    ringBufferPush(&rb, 0);
  }

  // while (rb.count > 0)
  // {
  //   int value = ringBufferPop(&rb);
  //   LOG_INF("%d ", value);
  //   LOG_INF("Read Index: %d, Write Index: %d, Count: %d", rb.readIndex, rb.writeIndex, rb.count);
  // }
  //
  while (true)
  {
    if (ui.GetButton1()) {
      LOG_INF("Push.");
      ringBufferPush(&rb, counter++);
      printBuffer(&rb);
      ui.ClearButton1();
    }
    if (ui.GetButton2()) {
      LOG_INF("Pop.");
      int value = ringBufferPop(&rb);
      LOG_INF("%d ", value);
      printBuffer(&rb);
      ui.ClearButton2();
    }
    k_msleep(20);
  }

  return 0;
}
```

## src/alc_ui.cpp
```c
#include <zephyr/logging/log.h>
#include "lib/alc_ui.h"

LOG_MODULE_REGISTER(alc_ui, LOG_LEVEL_INF);

namespace alc::ui
{
  static bool m_btn_1_pressed { false };
  static bool m_btn_2_pressed { false };
  static bool m_btn_3_pressed { false };
  static bool m_btn_4_pressed { false };
  
  void Ui::buttonHandler(uint32_t buttonState, uint32_t hasChanged)
  {
	  switch (hasChanged) 
    {
	    case DK_BTN1_MSK:
		    if (buttonState & DK_BTN1_MSK) { m_btn_1_pressed = true; }
	      break;
	    
      case DK_BTN2_MSK:
		    if (buttonState & DK_BTN2_MSK) { m_btn_2_pressed = true; }
	      break;
	    
      case DK_BTN3_MSK:
		    if (buttonState & DK_BTN3_MSK) { LOG_INF("Button 3 pressed."); }
	      break;
	    
      case DK_BTN4_MSK:
		    if (buttonState & DK_BTN4_MSK) { LOG_INF("Button 4 pressed."); }
	      break;
	  }
  }

  Ui::Ui(void)
  {
    int result = dk_leds_init();
    if (result != M_OK) { LOG_ERR("Failed to initialise LED library. Error: %d", result); }

	  result = dk_buttons_init(buttonHandler);
		if (result != M_OK) { LOG_ERR("Failed to initialise the buttons library: %d", result); }
  }

  bool Ui::GetButton1(void) { return m_btn_1_pressed; }

  bool Ui::GetButton2(void) { return m_btn_2_pressed; }

  bool Ui::GetButton3(void) { return m_btn_3_pressed; }

  bool Ui::GetButton4(void) { return m_btn_4_pressed; }

  void Ui::ClearButton1(void) { m_btn_1_pressed = false; }  

  void Ui::ClearButton2(void) { m_btn_2_pressed = false; }  

  void Ui::ClearButton3(void) { m_btn_3_pressed = false; }  

  void Ui::ClearButton4(void) { m_btn_4_pressed = false; }  
}
```
